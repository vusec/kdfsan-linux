## lib/Kconfig.kdfsan
```kconfig
# SPDX-License-Identifier: GPL-2.0

config HAVE_ARCH_KDFSAN
  bool

if HAVE_ARCH_KDFSAN

config KDFSAN
  bool "DataFlowSanitizer : generalised dynamic data flow analysis"
  default n

endif
```

## lib/Kconfig.kspecem
```kconfig
# SPDX-License-Identifier: GPL-2.0-only

config HAVE_ARCH_KSPECEM
  bool

if HAVE_ARCH_KSPECEM

config KSPECEM
  bool "kspecem: add checkpointing support"
  default n

endif
```
